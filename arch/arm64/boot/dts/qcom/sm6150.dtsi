// SPDX-License-Identifier: BSD-3-Clause
/*
 * SM6150 additions on top of QCS615/Talos.
 *
 * Board DTS must provide:
 *   &wifi { memory-region = <&wlan_msa_mem>; ... };
 * and the vdd-* supplies, before enabling the node.
 */

#include "talos.dtsi"

&soc {
	wifi: wifi@18800000 {
		compatible = "qcom,wcn3990-wifi";
		reg = <0x0 0x18800000 0x0 0x800000>;
		reg-names = "membase";
		iommus = <&apps_smmu 0x1640 0x1>;
		interrupts = <GIC_SPI 414 IRQ_TYPE_LEVEL_HIGH 0>, /* CE0 */
		<GIC_SPI 415 IRQ_TYPE_LEVEL_HIGH 0>,
		<GIC_SPI 416 IRQ_TYPE_LEVEL_HIGH 0>,
		<GIC_SPI 417 IRQ_TYPE_LEVEL_HIGH 0>,
		<GIC_SPI 418 IRQ_TYPE_LEVEL_HIGH 0>,
		<GIC_SPI 419 IRQ_TYPE_LEVEL_HIGH 0>,
		<GIC_SPI 420 IRQ_TYPE_LEVEL_HIGH 0>,
		<GIC_SPI 421 IRQ_TYPE_LEVEL_HIGH 0>,
		<GIC_SPI 422 IRQ_TYPE_LEVEL_HIGH 0>,
		<GIC_SPI 423 IRQ_TYPE_LEVEL_HIGH 0>,
		<GIC_SPI 424 IRQ_TYPE_LEVEL_HIGH 0>,
		<GIC_SPI 425 IRQ_TYPE_LEVEL_HIGH 0>; /* CE11 */
		status = "disabled";
	};
};
